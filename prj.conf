## CMakeLists.txt
```
# SPDX-License-Identifier: Apache-2.0

cmake_minimum_required(VERSION 3.20.0)
find_package(Zephyr REQUIRED HINTS $ENV{ZEPHYR_BASE})
project(zephyr_ccsds_eye_demo)

target_sources(app PRIVATE
    src/main.c
    src/demo_ui.c
    src/demo_protocol.c
    src/demo_image.c
    src/demo_view.c
    src/demo_sdls_feedback.c
    src/demo_camera.c
    src/demo_service.c
)
```

## Kconfig
```
# SPDX-License-Identifier: Apache-2.0

mainmenu "CCSDS EYE demo"

choice EYE_DEMO_ROLE
	prompt "Demo role"
	default EYE_DEMO_ROLE_A

config EYE_DEMO_ROLE_A
	bool "EYE A"

config EYE_DEMO_ROLE_B
	bool "EYE B"

endchoice

choice EYE_DEMO_LINK_SECURITY
	prompt "USLP link security"
	default EYE_DEMO_LINK_CLEAR

config EYE_DEMO_LINK_CLEAR
	bool "Clear USLP/COP-1"

config EYE_DEMO_LINK_SDLS
	bool "Stage 2 SDLS authenticated encryption"
	select CCSDS_SDLS
	select ENTROPY_GENERATOR
	help
	  Protect packet-bearing Type-AD frames with fixed prototype keys and a
	  bounded in-session ARSN check. Boot and local SYNC arm authenticated
	  receive-baseline adoption. While adoption is armed, a previously recorded
	  valid fixed-key frame can establish the baseline; fresh Stage 3 keys are
	  required to exclude that replay case.

endchoice

config EYE_DEMO_CALLSIGN
	string "Local callsign"
	default "EYE-1" if EYE_DEMO_ROLE_A
	default "EYE-2" if EYE_DEMO_ROLE_B

config EYE_DEMO_PEER_CALLSIGN
	string "Peer callsign"
	default "EYE-2" if EYE_DEMO_ROLE_A
	default "EYE-1" if EYE_DEMO_ROLE_B

config EYE_DEMO_LOCAL_ENTITY_ID
	int "Local CFDP entity ID"
	default 1 if EYE_DEMO_ROLE_A
	default 2 if EYE_DEMO_ROLE_B
	range 1 255

config EYE_DEMO_PEER_ENTITY_ID
	int "Peer CFDP entity ID"
	default 2 if EYE_DEMO_ROLE_A
	default 1 if EYE_DEMO_ROLE_B
	range 1 255

config EYE_DEMO_WIFI_SSID
	string "Wi-Fi SSID"
	default ""

config EYE_DEMO_WIFI_PASSWORD
	string "Wi-Fi WPA2 password"
	default ""

config EYE_DEMO_LOCAL_IPV4
	string "Local static IPv4 address"
	default "192.0.2.1"

config EYE_DEMO_PEER_IPV4
	string "Peer static IPv4 address"
	default "192.0.2.2"

config EYE_DEMO_NETMASK
	string "IPv4 netmask"
	default "255.255.255.0"

config EYE_DEMO_GATEWAY
	string "IPv4 gateway"
	default "192.0.2.254"

config EYE_DEMO_LOCAL_UDP_PORT
	int "Local UDP port"
	default 46001
	range 1024 65535

config EYE_DEMO_PEER_UDP_PORT
	int "Peer UDP port"
	default 46002
	range 1024 65535

config EYE_DEMO_CFDP_APID
	hex "CFDP Space Packet APID"
	default 0x350
	range 1 0x7ff

config EYE_DEMO_COMMAND_APID
	hex "CAPTURE_AND_RETURN TC APID"
	default 0x351
	range 1 0x7ff

config EYE_DEMO_COMMAND_STATUS_APID
	hex "Command status Space Packet APID"
	default 0x352
	range 1 0x7ff

config EYE_DEMO_PEER_STATUS_APID
	hex "Peer status Space Packet APID"
	default 0x353
	range 1 0x7ff

config EYE_DEMO_RECOVERY_APID
	hex "SDLS recovery election Space Packet APID"
	default 0x354
	range 1 0x7ff

config EYE_DEMO_OTAR_APID
	hex "SDLS recovery OTAR Space Packet APID"
	default 0x355
	range 1 0x7ff

config EYE_DEMO_LOCAL_SPACECRAFT_ID
	hex "Local USLP spacecraft ID"
	default 0x1001 if EYE_DEMO_ROLE_A
	default 0x1002 if EYE_DEMO_ROLE_B
	range 0 0xffff

config EYE_DEMO_PEER_SPACECRAFT_ID
	hex "Remote USLP spacecraft ID"
	default 0x1002 if EYE_DEMO_ROLE_A
	default 0x1001 if EYE_DEMO_ROLE_B
	range 0 0xffff

config EYE_DEMO_TRANSMIT_VCID
	int "Transmit USLP virtual channel ID"
	default 1
	range 0 62

config EYE_DEMO_RECEIVE_VCID
	int "Receive USLP virtual channel ID"
	default 1
	range 0 62

config EYE_DEMO_TRANSMIT_MAP_ID
	int "Transmit USLP MAP ID"
	default 3
	range 0 15

config EYE_DEMO_RECEIVE_MAP_ID
	int "Receive USLP MAP ID"
	default 3
	range 0 15

config EYE_DEMO_RETRANSMISSION_TIMEOUT_MS
	int "COP-1 retransmission timeout (ms)"
	default 500
	range 1 60000

config EYE_DEMO_FEEDBACK_INTERVAL_MS
	int "Idle repeated CLCW feedback interval (ms)"
	default 1000
	range 1 60000

config EYE_DEMO_MINIMUM_TRANSMIT_INTERVAL_MS
	int "Minimum USLP route interval (ms)"
	default 20
	range 1 1000

config EYE_DEMO_TRANSMISSION_LIMIT
	int "COP-1 transmission limit"
	default 12
	range 1 255

config EYE_DEMO_FARM_WINDOW_WIDTH
	int "COP-1 FARM window width"
	default 8
	range 2 254

config EYE_DEMO_INITIAL_TRANSMIT_SEQUENCE
	int "Initial transmit sequence"
	default 0
	range 0 255

config EYE_DEMO_INITIAL_RECEIVE_SEQUENCE
	int "Initial receive sequence"
	default 0
	range 0 255

choice EYE_DEMO_FAULT
	prompt "Deterministic USLP route fault"
	default EYE_DEMO_FAULT_NONE

config EYE_DEMO_FAULT_NONE
	bool "Disabled"

config EYE_DEMO_FAULT_DROP_DATA
	bool "Drop first packet-bearing frame during a transfer"

config EYE_DEMO_FAULT_DROP_FEEDBACK
	bool "Drop first feedback-only frame during a transfer"

config EYE_DEMO_FAULT_WITHHOLD_FEEDBACK
	bool "Withhold a bounded run of feedback-only frames during a transfer"

endchoice

config EYE_DEMO_FAULT_WITHHOLD_COUNT
	int "Number of feedback-only frames to withhold"
	default 12
	range 1 255

source "Kconfig.zephyr"
```

## west.yml
```
manifest:
  remotes:
    - name: zephyrproject
      url-base: https://github.com/zephyrproject-rtos
    - name: abarmitage
      url-base: https://github.com/abarmitage

  projects:
    - name: zephyr
      remote: zephyrproject
      revision: v4.3.0
      import: true
    - name: zephyr-ccsds
      remote: abarmitage
      revision: main
      path: modules/lib/ccsds

  self:
    path: ccsds-eye-demo
```

## prj.conf
```kconfig
CONFIG_DISPLAY=y
CONFIG_INPUT=y
CONFIG_VIDEO=y
CONFIG_VIDEO_BUFFER_POOL_SZ_MAX=115200
CONFIG_VIDEO_BUFFER_POOL_NUM_MAX=2
CONFIG_VIDEO_BUFFER_POOL_ALIGN=32
CONFIG_VIDEO_BUFFER_USE_SHARED_MULTI_HEAP=y
CONFIG_VIDEO_BUFFER_SMH_ATTRIBUTE=2
CONFIG_DMA_ESP32_MAX_DESCRIPTOR_NUM=64
CONFIG_ESP_SPIRAM=y
CONFIG_SPIRAM_MODE_OCT=y

CONFIG_LVGL=y
CONFIG_LV_CONF_MINIMAL=y
CONFIG_LV_COLOR_DEPTH_16=y
CONFIG_LV_Z_MEM_POOL_SIZE=32768
CONFIG_LV_Z_VDB_SIZE=10
CONFIG_LV_USE_BAR=y
CONFIG_LV_USE_LABEL=y

CONFIG_CCSDS=y
CONFIG_CCSDS_CFDP=y
CONFIG_CCSDS_FRAME_SUPPORT=y
CONFIG_CCSDS_TRANSFER_FRAME_USLP=y
CONFIG_CCSDS_USLP_FOP_WINDOW_K=4
CONFIG_EYE_DEMO_RETRANSMISSION_TIMEOUT_MS=1500
CONFIG_EYE_DEMO_FEEDBACK_INTERVAL_MS=1000
CONFIG_CCSDS_ROUTER_MAX_APIDS=6
CONFIG_CCSDS_CFDP_MAX_PDU_SIZE=988
CONFIG_CCSDS_CFDP_MAX_SEGMENT_SIZE=976
CONFIG_CCSDS_CFDP_MAX_NAK_RANGES=20
CONFIG_CCSDS_CFDP_MAX_NAK_ROUNDS=20
CONFIG_CCSDS_MAX_FRAME_LEN=1037
CONFIG_CCSDS_UDP_MAX_UNIT_LEN=1037
CONFIG_CCSDS_UDP_THREAD_STACK_SIZE=3072

CONFIG_NETWORKING=y
CONFIG_NET_IPV4=y
CONFIG_NET_IPV6=n
CONFIG_NET_UDP=y
CONFIG_NET_TCP=n
CONFIG_NET_SOCKETS=y
CONFIG_NET_DHCPV4=n
CONFIG_WIFI=y
CONFIG_WIFI_ESP32=y
CONFIG_WIFI_USAGE_MODE_STA=y
CONFIG_ESP32_WIFI_STA_AUTO_DHCPV4=n
CONFIG_ESP32_WIFI_STA_RECONNECT=y
CONFIG_NET_MGMT=y

CONFIG_LOG=y
CONFIG_LOG_DEFAULT_LEVEL=3
CONFIG_MAIN_STACK_SIZE=6144
CONFIG_SYSTEM_WORKQUEUE_STACK_SIZE=3072
```

## src/main.c
```c
/* SPDX-License-Identifier: Apache-2.0 */

#include <zephyr/device.h>
#include <zephyr/devicetree.h>
#include <zephyr/drivers/display.h>
#include <zephyr/input/input.h>
#include <zephyr/kernel.h>
#include <zephyr/logging/log.h>

#include <lvgl.h>

#include "demo_ui.h"
#include "demo_service.h"

LOG_MODULE_REGISTER(eye_demo, CONFIG_LOG_DEFAULT_LEVEL);

struct demo_key_event {
	uint16_t code;
	int32_t value;
};

K_MSGQ_DEFINE(key_events, sizeof(struct demo_key_event), 16, 4);

static void input_event(struct input_event *event, void *user_data)
{
	const struct demo_key_event key = {
		.code = event->code,
		.value = event->value,
	};

	ARG_UNUSED(user_data);

	if (event->type == INPUT_EV_KEY) {
		(void)k_msgq_put(&key_events, &key, K_NO_WAIT);
	}
}

INPUT_CALLBACK_DEFINE(NULL, input_event, NULL);

int main(void)
{
	const struct device *display = DEVICE_DT_GET(DT_CHOSEN(zephyr_display));
	struct demo_key_event key;

	if (!device_is_ready(display)) {
		LOG_ERR("display is not ready");
		return 0;
	}
	demo_ui_init();
	(void)lv_timer_handler();
	(void)display_blanking_off(display);
	if (demo_service_start() != 0) {
		LOG_ERR("protocol service failed to start");
	}

	while (true) {
		struct demo_ui_event ui_event;

		while (k_msgq_get(&key_events, &key, K_NO_WAIT) == 0) {
			LOG_INF("input code=%u value=%d", key.code, key.value);
			demo_ui_handle_key(key.code, key.value);
			if (key.value != 0 && demo_ui_link_active()) {
				enum demo_link_action action = 0;
				bool has_action = true;

				if (key.code == INPUT_KEY_DOWN) {
					demo_ui_leave_link();
					has_action = false;
				} else if (key.code == INPUT_KEY_MENU) {
					action = DEMO_LINK_UNLOCK;
				} else if (key.code == INPUT_KEY_PLAY) {
					action = DEMO_LINK_SET_VR;
				} else if (key.code == INPUT_KEY_UP) {
					action = DEMO_LINK_SYNC_TX;
				} else {
					has_action = false;
				}
				if (has_action) {
					if (demo_service_queue_link_action(action)) {
						demo_ui_report_link_queued(action);
					} else {
						LOG_WRN("link action queue full");
					}
				}
			} else if (key.value != 0 && key.code == INPUT_KEY_MENU) {
				demo_ui_prepare_action();
				if (!demo_service_queue_local_send()) {
					demo_ui_report_busy();
				}
			} else if (key.value != 0 && key.code == INPUT_KEY_PLAY) {
				demo_ui_prepare_action();
				if (!demo_service_queue_remote_request()) {
					demo_ui_report_busy();
				}
			} else if (key.value != 0 && key.code == INPUT_KEY_UP) {
				demo_ui_toggle_show();
			} else if (key.value != 0 && key.code == INPUT_KEY_DOWN) {
				demo_ui_enter_link();
			}
		}
		while (demo_service_get_ui_event(&ui_event)) {
			demo_ui_handle_event(&ui_event);
		}

		if (demo_ui_image_active()) {
			int rc = demo_ui_render_image(display);

			if (rc != 0) {
				LOG_ERR("image display failed: %d", rc);
			}
		} else {
			demo_ui_tick(k_uptime_get_32());
			(void)lv_timer_handler();
		}
		k_sleep(K_MSEC(10));
	}

	return 0;
}
```

## src/demo_camera.c
```c
/* SPDX-License-Identifier: Apache-2.0 */

#include "demo_camera.h"

#include <errno.h>
#include <string.h>

#include <zephyr/device.h>
#include <zephyr/devicetree.h>
#include <zephyr/drivers/video-controls.h>
#include <zephyr/drivers/video.h>
#include <zephyr/kernel.h>
#include <zephyr/logging/log.h>
#include <zephyr/sys/util.h>

#include <soc/soc_caps.h>
#include <hal/cache_hal.h>

LOG_MODULE_REGISTER(eye_camera, CONFIG_LOG_DEFAULT_LEVEL);

#define CAMERA_BUFFER_COUNT  2u
/* Let automatic exposure, gain, and white balance settle before saving a still. */
#define CAMERA_SETTLE_FRAMES 30u
#define CAMERA_TIMEOUT       K_SECONDS(2)

BUILD_ASSERT(DT_HAS_CHOSEN(zephyr_camera), "ESP32-S3-EYE camera must be chosen");
BUILD_ASSERT(!DT_PROP(DT_CHOSEN(zephyr_camera), invert_byte_order),
	     "image object requires VIDEO_PIX_FMT_RGB565 little-endian byte order");
BUILD_ASSERT(CONFIG_VIDEO_BUFFER_POOL_ALIGN >= CONFIG_ESP32S3_DATA_CACHE_LINE_SIZE,
	     "camera buffers must be aligned to an ESP32-S3 data-cache line");
BUILD_ASSERT(IS_ALIGNED(DEMO_IMAGE_PAYLOAD_SIZE, CONFIG_ESP32S3_DATA_CACHE_LINE_SIZE),
	     "camera frame size must contain complete ESP32-S3 data-cache lines");

struct zephyr_camera {
	const struct device *device;
	struct video_format format;
	struct video_buffer *buffers[CAMERA_BUFFER_COUNT];
	struct k_mutex capture_lock;
	bool initialized;
};

static struct zephyr_camera camera;

static void synchronize_dma_frame(void *buffer, size_t size)
{
	unsigned int key = irq_lock();

	/* This is a single-core build.  With interrupts locked and camera DMA
	 * stopped, no other execution context can touch the PSRAM cache while its
	 * stale lines are discarded.
	 */
	cache_hal_freeze(CACHE_TYPE_DATA);
	cache_hal_invalidate_addr((uint32_t)buffer, (uint32_t)size);
	cache_hal_unfreeze(CACHE_TYPE_DATA);
	irq_unlock(key);
}

static int rebuild_buffer_queue(struct zephyr_camera *context)
{
	struct video_buffer *returned = &(struct video_buffer){
		.type = VIDEO_BUF_TYPE_OUTPUT,
	};

	while (video_dequeue(context->device, &returned, K_NO_WAIT) == 0) {
		/* Drain completed or cancelled references before rebuilding the queue. */
	}
	for (size_t i = 0; i < ARRAY_SIZE(context->buffers); ++i) {
		int rc;

		__ASSERT_NO_MSG(context->buffers[i] != NULL);
		context->buffers[i]->type = VIDEO_BUF_TYPE_OUTPUT;
		context->buffers[i]->index = (uint8_t)i;
		context->buffers[i]->bytesused = 0u;
		context->buffers[i]->line_offset = 0u;
		rc = video_enqueue(context->device, context->buffers[i]);
		if (rc != 0) {
			return rc;
		}
	}
	return 0;
}

static int validate_frame(const struct zephyr_camera *context,
			  const struct video_buffer *frame)
{
	if (frame == NULL || frame->buffer == NULL || frame->size != context->format.size ||
	    frame->bytesused != context->format.size || frame->line_offset != 0u) {
		return -EMSGSIZE;
	}
	return 0;
}

static int stop_stream(struct zephyr_camera *context, bool *streaming, int rc)
{
	if (*streaming) {
		int stop_rc = video_stream_stop(context->device, VIDEO_BUF_TYPE_OUTPUT);

		*streaming = false;
		if (rc == 0) {
			rc = stop_rc;
		}
	}
	return rc;
}

static int zephyr_capture(void *opaque, uint8_t *pixels, size_t capacity,
			  struct demo_camera_frame_info *info)
{
	struct zephyr_camera *context = opaque;
	struct video_buffer *frame = NULL;
	bool streaming = false;
	int rc;

	if (context == NULL || !context->initialized || pixels == NULL || info == NULL ||
	    capacity != DEMO_IMAGE_PAYLOAD_SIZE) {
		return -EINVAL;
	}
	k_mutex_lock(&context->capture_lock, K_FOREVER);
	rc = rebuild_buffer_queue(context);
	if (rc == 0) {
		rc = video_stream_start(context->device, VIDEO_BUF_TYPE_OUTPUT);
		streaming = rc == 0;
	}
	for (uint32_t frame_number = 0u; rc == 0 && frame_number < CAMERA_SETTLE_FRAMES;
	     ++frame_number) {
		frame = &(struct video_buffer){
			.type = VIDEO_BUF_TYPE_OUTPUT,
		};
		rc = video_dequeue(context->device, &frame, CAMERA_TIMEOUT);
		if (rc == 0) {
			rc = validate_frame(context, frame);
		}
		if (rc == 0) {
			rc = video_enqueue(context->device, frame);
		}
	}
	rc = stop_stream(context, &streaming, rc);
	if (rc == 0) {
		rc = rebuild_buffer_queue(context);
	}
	if (rc == 0) {
		rc = video_stream_start(context->device, VIDEO_BUF_TYPE_OUTPUT);
		streaming = rc == 0;
	}
	if (rc == 0) {
		frame = &(struct video_buffer){
			.type = VIDEO_BUF_TYPE_OUTPUT,
		};
		rc = video_dequeue(context->device, &frame, CAMERA_TIMEOUT);
	}
	if (rc == 0) {
		rc = validate_frame(context, frame);
	}
	rc = stop_stream(context, &streaming, rc);
	if (rc == 0) {
		/* Camera GDMA writes the external-RAM buffer without updating the CPU
		 * cache.  The selected image is the first frame after freshly priming
		 * DMA, avoiding the continuous-stream handover that can lose pixels
		 * when Wi-Fi delays the frame-completion callback.
		 */
		synchronize_dma_frame(frame->buffer, frame->bytesused);
	}
	if (rc == 0) {
		memcpy(pixels, frame->buffer, frame->bytesused);
		*info = (struct demo_camera_frame_info){
			.width = context->format.width,
			.height = context->format.height,
			.stride = context->format.pitch,
			.pixel_format = DEMO_IMAGE_PIXEL_FORMAT_RGB565,
			.byte_order = DEMO_IMAGE_BYTE_ORDER_LITTLE_ENDIAN,
			.buffer_size = frame->size,
			.bytes_used = frame->bytesused,
		};
		LOG_INF("captured still after %u settling frames", CAMERA_SETTLE_FRAMES);
	}
	k_mutex_unlock(&context->capture_lock);
	return rc;
}

int demo_camera_init(struct demo_camera_adapter *adapter)
{
	struct video_caps caps = {.type = VIDEO_BUF_TYPE_OUTPUT};
	struct video_format actual = {.type = VIDEO_BUF_TYPE_OUTPUT};
	struct video_control flip = {
		.id = VIDEO_CID_VFLIP,
		.val = 1,
	};
	int rc;

	if (adapter == NULL) {
		return -EINVAL;
	}
	camera.device = DEVICE_DT_GET(DT_CHOSEN(zephyr_camera));
	if (!device_is_ready(camera.device)) {
		return -ENODEV;
	}
	rc = video_get_caps(camera.device, &caps);
	if (rc != 0 || caps.min_vbuf_count > CAMERA_BUFFER_COUNT) {
		return rc != 0 ? rc : -ENOBUFS;
	}
	camera.format = (struct video_format){
		.type = VIDEO_BUF_TYPE_OUTPUT,
		.pixelformat = VIDEO_PIX_FMT_RGB565,
		.width = DEMO_IMAGE_WIDTH,
		.height = DEMO_IMAGE_HEIGHT,
		.pitch = DEMO_IMAGE_STRIDE,
	};
	rc = video_set_compose_format(camera.device, &camera.format);
	if (rc != 0) {
		return rc;
	}
	rc = video_get_format(camera.device, &actual);
	if (rc != 0 || actual.pixelformat != VIDEO_PIX_FMT_RGB565 ||
	    actual.width != DEMO_IMAGE_WIDTH || actual.height != DEMO_IMAGE_HEIGHT ||
	    actual.pitch != DEMO_IMAGE_STRIDE || actual.size != DEMO_IMAGE_PAYLOAD_SIZE) {
		return rc != 0 ? rc : -ENOTSUP;
	}
	camera.format = actual;
	rc = video_set_ctrl(camera.device, &flip);
	if (rc != 0) {
		LOG_ERR("failed to set ESP32-S3-EYE vertical flip: %d", rc);
		return rc;
	}
	for (size_t i = 0; i < ARRAY_SIZE(camera.buffers); ++i) {
		camera.buffers[i] = video_buffer_aligned_alloc(
			DEMO_IMAGE_PAYLOAD_SIZE, CONFIG_VIDEO_BUFFER_POOL_ALIGN, K_NO_WAIT);
		if (camera.buffers[i] == NULL) {
			LOG_ERR("failed to allocate external video buffer %u", (unsigned int)i);
			return -ENOMEM;
		}
	}
	k_mutex_init(&camera.capture_lock);
	camera.initialized = true;
	*adapter = (struct demo_camera_adapter){
		.capture = zephyr_capture,
		.context = &camera,
	};
	LOG_INF("camera ready one-shot RGB565-LE %ux%u stride=%u bytes=%u settle=%u",
		camera.format.width, camera.format.height, camera.format.pitch, camera.format.size,
		CAMERA_SETTLE_FRAMES);
	return 0;
}
```

## src/demo_camera.h
```c
/* SPDX-License-Identifier: Apache-2.0 */

#ifndef CCSDS_EYE_DEMO_CAMERA_H
#define CCSDS_EYE_DEMO_CAMERA_H

#include "demo_image.h"

int demo_camera_init(struct demo_camera_adapter *adapter);

#endif /* CCSDS_EYE_DEMO_CAMERA_H */
```

## src/demo_image.c
```c
/* SPDX-License-Identifier: Apache-2.0 */

#include "demo_image.h"

#include <errno.h>
#include <string.h>

#include <zephyr/sys/__assert.h>
#include <zephyr/sys/byteorder.h>
#include <zephyr/sys/util.h>

BUILD_ASSERT(sizeof(struct demo_image_object) == DEMO_IMAGE_OBJECT_SIZE,
	     "image object layout must remain fixed");

enum image_header_offset {
	IMAGE_MAGIC = 0,
	IMAGE_VERSION = 4,
	IMAGE_HEADER_LENGTH = 6,
	IMAGE_WIDTH = 8,
	IMAGE_HEIGHT = 10,
	IMAGE_PIXEL_FORMAT = 12,
	IMAGE_BYTE_ORDER = 13,
	IMAGE_STRIDE = 14,
	IMAGE_PAYLOAD_SIZE = 16,
};

static bool metadata_valid(const struct demo_image_metadata *metadata)
{
	return metadata != NULL && metadata->width == DEMO_IMAGE_WIDTH &&
	       metadata->height == DEMO_IMAGE_HEIGHT && metadata->stride == DEMO_IMAGE_STRIDE &&
	       metadata->pixel_format == DEMO_IMAGE_PIXEL_FORMAT_RGB565 &&
	       metadata->byte_order == DEMO_IMAGE_BYTE_ORDER_LITTLE_ENDIAN &&
	       metadata->payload_size == DEMO_IMAGE_PAYLOAD_SIZE;
}

void demo_image_expected_metadata(struct demo_image_metadata *metadata)
{
	__ASSERT_NO_MSG(metadata != NULL);
	*metadata = (struct demo_image_metadata){
		.width = DEMO_IMAGE_WIDTH,
		.height = DEMO_IMAGE_HEIGHT,
		.stride = DEMO_IMAGE_STRIDE,
		.pixel_format = DEMO_IMAGE_PIXEL_FORMAT_RGB565,
		.byte_order = DEMO_IMAGE_BYTE_ORDER_LITTLE_ENDIAN,
		.payload_size = DEMO_IMAGE_PAYLOAD_SIZE,
	};
}

static int encode_header(struct demo_image_object *object, size_t capacity,
			 const struct demo_image_metadata *metadata, size_t pixel_size)
{
	if (object == NULL || capacity < sizeof(*object) || !metadata_valid(metadata) ||
	    pixel_size != DEMO_IMAGE_PAYLOAD_SIZE) {
		return -EINVAL;
	}

	memset(object->header, 0, sizeof(object->header));
	sys_put_be32(DEMO_IMAGE_MAGIC, &object->header[IMAGE_MAGIC]);
	sys_put_be16(DEMO_IMAGE_VERSION, &object->header[IMAGE_VERSION]);
	sys_put_be16(DEMO_IMAGE_HEADER_SIZE, &object->header[IMAGE_HEADER_LENGTH]);
	sys_put_be16(metadata->width, &object->header[IMAGE_WIDTH]);
	sys_put_be16(metadata->height, &object->header[IMAGE_HEIGHT]);
	object->header[IMAGE_PIXEL_FORMAT] = (uint8_t)metadata->pixel_format;
	object->header[IMAGE_BYTE_ORDER] = (uint8_t)metadata->byte_order;
	sys_put_be16(metadata->stride, &object->header[IMAGE_STRIDE]);
	sys_put_be32(metadata->payload_size, &object->header[IMAGE_PAYLOAD_SIZE]);
	return 0;
}

int demo_image_encode(struct demo_image_object *object, size_t capacity,
		      const struct demo_image_metadata *metadata, const uint8_t *pixels,
		      size_t pixel_size)
{
	int rc = encode_header(object, capacity, metadata, pixel_size);

	if (rc != 0 || pixels == NULL) {
		return -EINVAL;
	}
	memcpy(object->pixels, pixels, pixel_size);
	return demo_image_validate(object, sizeof(*object));
}

int demo_image_encode_in_place(struct demo_image_object *object, size_t capacity,
			       const struct demo_image_metadata *metadata, size_t pixel_size)
{
	int rc = encode_header(object, capacity, metadata, pixel_size);

	return rc == 0 ? demo_image_validate(object, sizeof(*object)) : rc;
}

int demo_image_validate(const struct demo_image_object *object, size_t object_size)
{
	if (object == NULL || object_size != sizeof(*object) ||
	    sys_get_be32(&object->header[IMAGE_MAGIC]) != DEMO_IMAGE_MAGIC ||
	    sys_get_be16(&object->header[IMAGE_VERSION]) != DEMO_IMAGE_VERSION ||
	    sys_get_be16(&object->header[IMAGE_HEADER_LENGTH]) != DEMO_IMAGE_HEADER_SIZE ||
	    sys_get_be16(&object->header[IMAGE_WIDTH]) != DEMO_IMAGE_WIDTH ||
	    sys_get_be16(&object->header[IMAGE_HEIGHT]) != DEMO_IMAGE_HEIGHT ||
	    object->header[IMAGE_PIXEL_FORMAT] != DEMO_IMAGE_PIXEL_FORMAT_RGB565 ||
	    object->header[IMAGE_BYTE_ORDER] != DEMO_IMAGE_BYTE_ORDER_LITTLE_ENDIAN ||
	    sys_get_be16(&object->header[IMAGE_STRIDE]) != DEMO_IMAGE_STRIDE ||
	    sys_get_be32(&object->header[IMAGE_PAYLOAD_SIZE]) != DEMO_IMAGE_PAYLOAD_SIZE) {
		return -EINVAL;
	}

	for (size_t i = IMAGE_PAYLOAD_SIZE + sizeof(uint32_t); i < DEMO_IMAGE_HEADER_SIZE; ++i) {
		if (object->header[i] != 0u) {
			return -EINVAL;
		}
	}
	return 0;
}

int demo_camera_acquire_object(const struct demo_camera_adapter *adapter,
			       struct demo_image_object *object)
{
	struct demo_camera_frame_info info = {0};
	struct demo_image_metadata metadata;
	int rc;

	if (adapter == NULL || adapter->capture == NULL || object == NULL) {
		return -EINVAL;
	}
	rc = adapter->capture(adapter->context, object->pixels, sizeof(object->pixels), &info);
	if (rc != 0) {
		return rc;
	}
	metadata = (struct demo_image_metadata){
		.width = info.width,
		.height = info.height,
		.stride = info.stride,
		.pixel_format = info.pixel_format,
		.byte_order = info.byte_order,
		.payload_size = (uint32_t)info.bytes_used,
	};
	if (info.buffer_size != DEMO_IMAGE_PAYLOAD_SIZE ||
	    info.bytes_used != DEMO_IMAGE_PAYLOAD_SIZE) {
		return -EMSGSIZE;
	}
	return demo_image_encode_in_place(object, sizeof(*object), &metadata, info.bytes_used);
}

void demo_image_store_init(struct demo_image_store *store, struct demo_image_slot *slots,
			   struct demo_image_object *objects, size_t slot_count)
{
	__ASSERT_NO_MSG(store != NULL);
	__ASSERT_NO_MSG(slots != NULL);
	__ASSERT_NO_MSG(objects != NULL);
	__ASSERT_NO_MSG(slot_count >= DEMO_IMAGE_SLOT_COUNT);
	memset(slots, 0, sizeof(*slots) * slot_count);
	for (size_t i = 0; i < slot_count; ++i) {
		slots[i].object = &objects[i];
	}
	store->slots = slots;
	store->slot_count = slot_count;
}

static bool slot_belongs(const struct demo_image_store *store, const struct demo_image_slot *slot)
{
	return store != NULL && store->slots != NULL && slot >= store->slots &&
	       slot < store->slots + store->slot_count;
}

bool demo_image_store_valid(const struct demo_image_store *store)
{
	size_t latest = 0u;
	size_t staging = 0u;

	if (store == NULL || store->slots == NULL || store->slot_count < DEMO_IMAGE_SLOT_COUNT) {
		return false;
	}
	for (size_t i = 0; i < store->slot_count; ++i) {
		const uint8_t owners = store->slots[i].owners;

		if (store->slots[i].object == NULL ||
		    (owners & ~(DEMO_IMAGE_OWNER_STAGING | DEMO_IMAGE_OWNER_LATEST |
				DEMO_IMAGE_OWNER_DISPLAY | DEMO_IMAGE_OWNER_TX)) != 0u ||
		    ((owners & DEMO_IMAGE_OWNER_STAGING) != 0u &&
		     owners != DEMO_IMAGE_OWNER_STAGING)) {
			return false;
		}
		latest += (owners & DEMO_IMAGE_OWNER_LATEST) != 0u;
		staging += (owners & DEMO_IMAGE_OWNER_STAGING) != 0u;
	}
	return latest <= 1u && staging <= 1u;
}

static void assert_store(const struct demo_image_store *store)
{
	__ASSERT_NO_MSG(demo_image_store_valid(store));
}

int demo_image_store_claim_staging(struct demo_image_store *store, struct demo_image_slot **slot)
{
	if (slot == NULL || !demo_image_store_valid(store)) {
		return -EINVAL;
	}
	for (size_t i = 0; i < store->slot_count; ++i) {
		if ((store->slots[i].owners & DEMO_IMAGE_OWNER_STAGING) != 0u) {
			return -EBUSY;
		}
	}
	for (size_t i = 0; i < store->slot_count; ++i) {
		if (store->slots[i].owners == DEMO_IMAGE_OWNER_NONE) {
			store->slots[i].owners = DEMO_IMAGE_OWNER_STAGING;
			*slot = &store->slots[i];
			assert_store(store);
			return 0;
		}
	}
	return -EBUSY;
}

int demo_image_store_abort_staging(struct demo_image_store *store, struct demo_image_slot *slot)
{
	if (!slot_belongs(store, slot) || slot->owners != DEMO_IMAGE_OWNER_STAGING) {
		return -EINVAL;
	}
	slot->owners = DEMO_IMAGE_OWNER_NONE;
	assert_store(store);
	return 0;
}

int demo_image_store_promote(struct demo_image_store *store, struct demo_image_slot *slot)
{
	if (!slot_belongs(store, slot) || slot->owners != DEMO_IMAGE_OWNER_STAGING ||
	    demo_image_validate(slot->object, sizeof(*slot->object)) != 0) {
		return -EINVAL;
	}
	for (size_t i = 0; i < store->slot_count; ++i) {
		store->slots[i].owners &= (uint8_t)~DEMO_IMAGE_OWNER_LATEST;
	}
	slot->owners = DEMO_IMAGE_OWNER_LATEST;
	assert_store(store);
	return 0;
}

int demo_image_store_acquire_display(struct demo_image_store *store, struct demo_image_slot **slot)
{
	if (slot == NULL || !demo_image_store_valid(store)) {
		return -EINVAL;
	}
	for (size_t i = 0; i < store->slot_count; ++i) {
		if ((store->slots[i].owners & DEMO_IMAGE_OWNER_DISPLAY) != 0u) {
			return -EBUSY;
		}
	}
	for (size_t i = 0; i < store->slot_count; ++i) {
		if ((store->slots[i].owners & DEMO_IMAGE_OWNER_LATEST) != 0u) {
			store->slots[i].owners |= DEMO_IMAGE_OWNER_DISPLAY;
			*slot = &store->slots[i];
			assert_store(store);
			return 0;
		}
	}
	return -ENOENT;
}

int demo_image_store_release_display(struct demo_image_store *store, struct demo_image_slot *slot)
{
	if (!slot_belongs(store, slot) || (slot->owners & DEMO_IMAGE_OWNER_DISPLAY) == 0u) {
		return -EINVAL;
	}
	slot->owners &= (uint8_t)~DEMO_IMAGE_OWNER_DISPLAY;
	assert_store(store);
	return 0;
}

int demo_image_store_retain_tx(struct demo_image_store *store, struct demo_image_slot *slot)
{
	if (!slot_belongs(store, slot) || slot->owners == DEMO_IMAGE_OWNER_NONE ||
	    (slot->owners & DEMO_IMAGE_OWNER_STAGING) != 0u ||
	    (slot->owners & DEMO_IMAGE_OWNER_TX) != 0u) {
		return -EINVAL;
	}
	slot->owners |= DEMO_IMAGE_OWNER_TX;
	assert_store(store);
	return 0;
}

int demo_image_store_release_tx(struct demo_image_store *store, struct demo_image_slot *slot)
{
	if (!slot_belongs(store, slot) || (slot->owners & DEMO_IMAGE_OWNER_TX) == 0u) {
		return -EINVAL;
	}
	slot->owners &= (uint8_t)~DEMO_IMAGE_OWNER_TX;
	assert_store(store);
	return 0;
}

void demo_image_source_init(struct demo_image_source *source)
{
	__ASSERT_NO_MSG(source != NULL);
	memset(source, 0, sizeof(*source));
}

int demo_image_source_bind(struct demo_image_source *source, struct demo_image_slot *slot)
{
	if (source == NULL || slot == NULL || source->slot != NULL || source->open ||
	    (slot->owners & DEMO_IMAGE_OWNER_TX) == 0u ||
	    demo_image_validate(slot->object, sizeof(*slot->object)) != 0) {
		return -EINVAL;
	}
	source->slot = slot;
	return 0;
}

int demo_image_source_open(struct demo_image_source *source, const char *path, void **handle,
			   uint32_t *size)
{
	if (source == NULL || path == NULL || handle == NULL || size == NULL ||
	    strcmp(path, DEMO_IMAGE_SOURCE_PATH) != 0 || source->slot == NULL || source->open ||
	    (source->slot->owners & DEMO_IMAGE_OWNER_TX) == 0u) {
		return -EINVAL;
	}
	source->open = true;
	*handle = source->slot->object;
	*size = DEMO_IMAGE_OBJECT_SIZE;
	return 0;
}

int demo_image_source_read(struct demo_image_source *source, void *handle, uint32_t offset,
			   uint8_t *buffer, size_t length, size_t *read_length)
{
	size_t available;

	if (source == NULL || handle == NULL || buffer == NULL || read_length == NULL ||
	    !source->open || source->slot == NULL || handle != source->slot->object ||
	    offset > DEMO_IMAGE_OBJECT_SIZE ||
	    (source->slot->owners & DEMO_IMAGE_OWNER_TX) == 0u) {
		return -EINVAL;
	}
	available = DEMO_IMAGE_OBJECT_SIZE - offset;
	*read_length = MIN(length, available);
	memcpy(buffer, &((const uint8_t *)source->slot->object)[offset], *read_length);
	return 0;
}

int demo_image_source_close(struct demo_image_source *source, void *handle)
{
	if (source == NULL || !source->open || source->slot == NULL ||
	    handle != source->slot->object) {
		return -EINVAL;
	}
	source->open = false;
	return 0;
}

void demo_image_source_unbind(struct demo_image_source *source)
{
	__ASSERT_NO_MSG(source != NULL);
	__ASSERT_NO_MSG(!source->open);
	source->slot = NULL;
}

void demo_image_receiver_init(struct demo_image_receiver *receiver,
			      struct demo_image_store *store)
{
	__ASSERT_NO_MSG(receiver != NULL);
	__ASSERT_NO_MSG(demo_image_store_valid(store));
	memset(receiver, 0, sizeof(*receiver));
	receiver->store = store;
}

int demo_image_receiver_open(struct demo_image_receiver *receiver, const char *path,
			     void **handle)
{
	int rc;

	if (receiver == NULL || path == NULL || handle == NULL ||
	    strcmp(path, DEMO_IMAGE_DEST_PATH) != 0 || receiver->open ||
	    receiver->staging != NULL || !demo_image_store_valid(receiver->store)) {
		return -EINVAL;
	}
	rc = demo_image_store_claim_staging(receiver->store, &receiver->staging);
	if (rc != 0) {
		return rc;
	}
	memset(receiver->staging->object, 0, sizeof(*receiver->staging->object));
	receiver->extent = 0u;
	receiver->validated = false;
	receiver->open = true;
	*handle = receiver->staging->object;
	return 0;
}

int demo_image_receiver_write(struct demo_image_receiver *receiver, void *handle,
			      uint32_t offset, const uint8_t *buffer, size_t length)
{
	size_t end;

	if (receiver == NULL || handle == NULL || (buffer == NULL && length != 0u) ||
	    !receiver->open || receiver->staging == NULL ||
	    handle != receiver->staging->object) {
		return -EINVAL;
	}
	if (offset > DEMO_IMAGE_OBJECT_SIZE || length > DEMO_IMAGE_OBJECT_SIZE - offset) {
		return -EFBIG;
	}
	end = (size_t)offset + length;
	if (length != 0u) {
		memcpy(&((uint8_t *)receiver->staging->object)[offset], buffer, length);
	}
	receiver->extent = MAX(receiver->extent, end);
	return 0;
}

int demo_image_receiver_read(struct demo_image_receiver *receiver, void *handle, uint32_t offset,
			     uint8_t *buffer, size_t length, size_t *read_length)
{
	size_t available;

	if (receiver == NULL || handle == NULL || buffer == NULL || read_length == NULL ||
	    !receiver->open || receiver->staging == NULL ||
	    handle != receiver->staging->object || offset > receiver->extent) {
		return -EINVAL;
	}
	available = receiver->extent - offset;
	*read_length = MIN(length, available);
	memcpy(buffer, &((const uint8_t *)receiver->staging->object)[offset], *read_length);
	return 0;
}

int demo_image_receiver_close(struct demo_image_receiver *receiver, void *handle)
{
	if (receiver == NULL || !receiver->open || receiver->staging == NULL ||
	    handle != receiver->staging->object) {
		return -EINVAL;
	}
	receiver->open = false;
	return 0;
}

int demo_image_receiver_validate_complete(struct demo_image_receiver *receiver,
					 const char *path)
{
	if (receiver == NULL || path == NULL || strcmp(path, DEMO_IMAGE_DEST_PATH) != 0 ||
	    receiver->open || receiver->staging == NULL || receiver->validated ||
	    receiver->extent != DEMO_IMAGE_OBJECT_SIZE ||
	    demo_image_validate(receiver->staging->object, receiver->extent) != 0) {
		return -EBADMSG;
	}
	receiver->validated = true;
	return 0;
}

int demo_image_receiver_discard(struct demo_image_receiver *receiver, const char *path)
{
	if (receiver == NULL || path == NULL || strcmp(path, DEMO_IMAGE_DEST_PATH) != 0) {
		return -EINVAL;
	}
	return demo_image_receiver_terminal(receiver, false);
}

int demo_image_receiver_terminal(struct demo_image_receiver *receiver, bool success)
{
	int rc = 0;

	if (receiver == NULL || receiver->store == NULL) {
		return -EINVAL;
	}
	if (receiver->staging == NULL) {
		return success ? -EINVAL : 0;
	}
	if (receiver->open) {
		receiver->open = false;
	}
	if (success && receiver->validated) {
		rc = demo_image_store_promote(receiver->store, receiver->staging);
	} else {
		rc = demo_image_store_abort_staging(receiver->store, receiver->staging);
		if (success && rc == 0) {
			rc = -EBADMSG;
		}
	}
	receiver->staging = NULL;
	receiver->extent = 0u;
	receiver->validated = false;
	return rc;
}
```

## src/demo_image.h
```c
/* SPDX-License-Identifier: Apache-2.0 */

#ifndef CCSDS_EYE_DEMO_IMAGE_H
#define CCSDS_EYE_DEMO_IMAGE_H

#include <stdbool.h>
#include <stddef.h>
#include <stdint.h>

#define DEMO_IMAGE_MAGIC        0x45594549u /* "EYEI" */
#define DEMO_IMAGE_VERSION      1u
#define DEMO_IMAGE_WIDTH        240u
#define DEMO_IMAGE_HEIGHT       240u
#define DEMO_IMAGE_STRIDE       480u
#define DEMO_IMAGE_PAYLOAD_SIZE 115200u
#define DEMO_IMAGE_HEADER_SIZE  32u
#define DEMO_IMAGE_OBJECT_SIZE  (DEMO_IMAGE_HEADER_SIZE + DEMO_IMAGE_PAYLOAD_SIZE)
#define DEMO_IMAGE_SLOT_COUNT   3u
#define DEMO_IMAGE_SOURCE_PATH  "eye-image-v1.bin"
#define DEMO_IMAGE_DEST_PATH    "eye-received-image-v1.bin"

enum demo_image_pixel_format {
	DEMO_IMAGE_PIXEL_FORMAT_RGB565 = 1,
};

enum demo_image_byte_order {
	DEMO_IMAGE_BYTE_ORDER_LITTLE_ENDIAN = 1,
};

struct demo_image_metadata {
	uint16_t width;
	uint16_t height;
	uint16_t stride;
	enum demo_image_pixel_format pixel_format;
	enum demo_image_byte_order byte_order;
	uint32_t payload_size;
};

struct demo_image_object {
	uint8_t header[DEMO_IMAGE_HEADER_SIZE];
	uint8_t pixels[DEMO_IMAGE_PAYLOAD_SIZE];
};

enum demo_image_owner {
	DEMO_IMAGE_OWNER_NONE = 0,
	DEMO_IMAGE_OWNER_STAGING = 1u << 0,
	DEMO_IMAGE_OWNER_LATEST = 1u << 1,
	DEMO_IMAGE_OWNER_DISPLAY = 1u << 2,
	DEMO_IMAGE_OWNER_TX = 1u << 3,
};

struct demo_image_slot {
	struct demo_image_object *object;
	uint8_t owners;
};

struct demo_image_store {
	struct demo_image_slot *slots;
	size_t slot_count;
};

struct demo_image_source {
	struct demo_image_slot *slot;
	bool open;
};

struct demo_image_receiver {
	struct demo_image_store *store;
	struct demo_image_slot *staging;
	size_t extent;
	bool open;
	bool validated;
};

struct demo_camera_frame_info {
	uint16_t width;
	uint16_t height;
	uint16_t stride;
	enum demo_image_pixel_format pixel_format;
	enum demo_image_byte_order byte_order;
	size_t buffer_size;
	size_t bytes_used;
};

typedef int (*demo_camera_capture_fn)(void *context, uint8_t *pixels, size_t capacity,
				      struct demo_camera_frame_info *info);

struct demo_camera_adapter {
	demo_camera_capture_fn capture;
	void *context;
};

void demo_image_expected_metadata(struct demo_image_metadata *metadata);
int demo_image_encode(struct demo_image_object *object, size_t capacity,
		      const struct demo_image_metadata *metadata, const uint8_t *pixels,
		      size_t pixel_size);
int demo_image_encode_in_place(struct demo_image_object *object, size_t capacity,
			       const struct demo_image_metadata *metadata, size_t pixel_size);
int demo_image_validate(const struct demo_image_object *object, size_t object_size);
int demo_camera_acquire_object(const struct demo_camera_adapter *adapter,
			       struct demo_image_object *object);

void demo_image_store_init(struct demo_image_store *store, struct demo_image_slot *slots,
			   struct demo_image_object *objects, size_t slot_count);
bool demo_image_store_valid(const struct demo_image_store *store);
int demo_image_store_claim_staging(struct demo_image_store *store, struct demo_image_slot **slot);
int demo_image_store_abort_staging(struct demo_image_store *store, struct demo_image_slot *slot);
int demo_image_store_promote(struct demo_image_store *store, struct demo_image_slot *slot);
int demo_image_store_acquire_display(struct demo_image_store *store, struct demo_image_slot **slot);
int demo_image_store_release_display(struct demo_image_store *store, struct demo_image_slot *slot);
int demo_image_store_retain_tx(struct demo_image_store *store, struct demo_image_slot *slot);
int demo_image_store_release_tx(struct demo_image_store *store, struct demo_image_slot *slot);

void demo_image_source_init(struct demo_image_source *source);
int demo_image_source_bind(struct demo_image_source *source, struct demo_image_slot *slot);
int demo_image_source_open(struct demo_image_source *source, const char *path, void **handle,
			   uint32_t *size);
int demo_image_source_read(struct demo_image_source *source, void *handle, uint32_t offset,
			   uint8_t *buffer, size_t length, size_t *read_length);
int demo_image_source_close(struct demo_image_source *source, void *handle);
void demo_image_source_unbind(struct demo_image_source *source);

void demo_image_receiver_init(struct demo_image_receiver *receiver,
			      struct demo_image_store *store);
int demo_image_receiver_open(struct demo_image_receiver *receiver, const char *path,
			     void **handle);
int demo_image_receiver_write(struct demo_image_receiver *receiver, void *handle,
			      uint32_t offset, const uint8_t *buffer, size_t length);
int demo_image_receiver_read(struct demo_image_receiver *receiver, void *handle, uint32_t offset,
			     uint8_t *buffer, size_t length, size_t *read_length);
int demo_image_receiver_close(struct demo_image_receiver *receiver, void *handle);
int demo_image_receiver_validate_complete(struct demo_image_receiver *receiver,
					 const char *path);
int demo_image_receiver_discard(struct demo_image_receiver *receiver, const char *path);
int demo_image_receiver_terminal(struct demo_image_receiver *receiver, bool success);

#endif /* CCSDS_EYE_DEMO_IMAGE_H */
```

## src/demo_protocol.h
```c
/* SPDX-License-Identifier: Apache-2.0 */

#ifndef CCSDS_EYE_DEMO_PROTOCOL_H
#define CCSDS_EYE_DEMO_PROTOCOL_H

#include <stdbool.h>
#include <stddef.h>
#include <stdint.h>

#define DEMO_PROTOCOL_VERSION    2u
#define DEMO_CALLSIGN_LEN        8u
#define DEMO_CAPTURE_COMMAND_LEN 12u
#define DEMO_COMMAND_STATUS_LEN  16u
#define DEMO_PEER_STATUS_LEN     68u
#define DEMO_DEDUP_CAPACITY      8u
#define DEMO_ELECTION_VALUE_LEN  12u
#define DEMO_ELECTION_ANNOUNCEMENT_LEN 20u

enum demo_message_type {
	DEMO_MSG_CAPTURE_AND_RETURN = 1,
	DEMO_MSG_COMMAND_STATUS = 2,
	DEMO_MSG_PEER_STATUS = 3,
	DEMO_MSG_ELECTION_CANDIDATE = 4,
};

enum demo_election_result {
	DEMO_ELECTION_WAITING = 0,
	DEMO_ELECTION_WON,
	DEMO_ELECTION_LOST,
	DEMO_ELECTION_TIMED_OUT,
};

struct demo_election_candidate {
	uint8_t value[DEMO_ELECTION_VALUE_LEN];
	uint32_t attempt_id;
	uint16_t spacecraft_id;
};

struct demo_recovery_election {
	struct demo_election_candidate local;
	struct demo_election_candidate peer;
	uint64_t deadline_ms;
	enum demo_election_result result;
	bool active;
	bool peer_valid;
};

struct demo_clcw_divergence {
	uint64_t first_seen_ms;
	uint8_t report_value;
	bool observed;
};

enum demo_command_result {
	DEMO_COMMAND_ACCEPTED = 0,
	DEMO_COMMAND_BUSY = 1,
	DEMO_COMMAND_INVALID = 2,
	DEMO_COMMAND_DUPLICATE = 3,
	DEMO_COMMAND_TIMED_OUT = 4,
};

enum demo_peer_validation {
	DEMO_PEER_VALID = 0,
	DEMO_PEER_INCOMPATIBLE,
	DEMO_PEER_DUPLICATE_ENTITY,
	DEMO_PEER_WRONG_ENTITY,
	DEMO_PEER_CONFIG_MISMATCH,
};

struct demo_capture_command {
	uint32_t request_id;
	uint64_t requesting_entity_id;
};

struct demo_command_status {
	uint32_t request_id;
	uint64_t responding_entity_id;
	enum demo_command_result result;
};

struct demo_peer_status {
	uint64_t entity_id;
	uint64_t expected_peer_entity_id;
	uint32_t local_ipv4;
	uint32_t peer_ipv4;
	uint16_t local_udp_port;
	uint16_t peer_udp_port;
	uint16_t cfdp_apid;
	uint16_t command_apid;
	uint16_t command_status_apid;
	uint16_t peer_status_apid;
	char callsign[DEMO_CALLSIGN_LEN];
	uint16_t local_spacecraft_id;
	uint16_t peer_spacecraft_id;
	uint8_t transmit_vcid;
	uint8_t receive_vcid;
	uint8_t transmit_map_id;
	uint8_t receive_map_id;
	uint16_t maximum_frame_length;
	uint8_t cop1_window_k;
	uint8_t farm_window_width;
	uint16_t minimum_transmit_interval_ms;
	uint16_t retransmission_timeout_ms;
	uint16_t feedback_interval_ms;
	uint8_t transmission_limit;
	uint8_t initial_transmit_sequence;
	uint8_t initial_receive_sequence;
};

struct demo_peer_expectation {
	uint64_t local_entity_id;
	uint64_t peer_entity_id;
	uint32_t local_ipv4;
	uint32_t peer_ipv4;
	uint16_t local_udp_port;
	uint16_t peer_udp_port;
	uint16_t cfdp_apid;
	uint16_t command_apid;
	uint16_t command_status_apid;
	uint16_t peer_status_apid;
	char peer_callsign[DEMO_CALLSIGN_LEN];
	uint16_t local_spacecraft_id;
	uint16_t peer_spacecraft_id;
	uint8_t transmit_vcid;
	uint8_t receive_vcid;
	uint8_t transmit_map_id;
	uint8_t receive_map_id;
	uint16_t maximum_frame_length;
	uint8_t cop1_window_k;
	uint8_t farm_window_width;
	uint16_t minimum_transmit_interval_ms;
	uint16_t retransmission_timeout_ms;
	uint16_t feedback_interval_ms;
	uint8_t transmission_limit;
	uint8_t initial_transmit_sequence;
	uint8_t initial_receive_sequence;
};

struct demo_dedup_entry {
	uint64_t entity_id;
	uint32_t request_id;
	uint64_t expires_ms;
	bool active;
};

struct demo_dedup_cache {
	struct demo_dedup_entry entries[DEMO_DEDUP_CAPACITY];
	size_t next;
};

int demo_capture_command_encode(const struct demo_capture_command *command, uint8_t *buffer,
				size_t capacity);
int demo_capture_command_decode(const uint8_t *buffer, size_t length,
				struct demo_capture_command *command);
int demo_command_status_encode(const struct demo_command_status *status, uint8_t *buffer,
			       size_t capacity);
int demo_command_status_decode(const uint8_t *buffer, size_t length,
			       struct demo_command_status *status);
int demo_peer_status_encode(const struct demo_peer_status *status, uint8_t *buffer,
			    size_t capacity);
int demo_peer_status_decode(const uint8_t *buffer, size_t length, struct demo_peer_status *status);
enum demo_peer_validation demo_peer_status_validate(const struct demo_peer_status *status,
						    const struct demo_peer_expectation *expected);
bool demo_dedup_check_and_record(struct demo_dedup_cache *cache, uint64_t entity_id,
				 uint32_t request_id, uint64_t now_ms, uint64_t retention_ms);
uint8_t demo_transfer_percent(uint32_t bytes_transferred, uint32_t file_size);
int demo_election_announcement_encode(
	const struct demo_election_candidate *candidate, uint8_t *buffer,
	size_t capacity);
int demo_election_announcement_decode(
	const uint8_t *buffer, size_t length,
	struct demo_election_candidate *candidate);
int demo_recovery_election_start(
	struct demo_recovery_election *election,
	const struct demo_election_candidate *local, uint64_t deadline_ms);
int demo_recovery_election_receive(
	struct demo_recovery_election *election, const uint8_t *buffer,
	size_t length, uint16_t expected_peer_spacecraft_id);
void demo_recovery_election_tick(struct demo_recovery_election *election,
				 uint64_t now_ms);
/** Ordinary application traffic stays paused until mutual new-key confirmation. */
bool demo_recovery_application_tx_allowed(
	const struct demo_recovery_election *election, bool confirmed);
/** Only the winner may send the first operational confirmation after cutover. */
bool demo_recovery_status_tx_allowed(
	const struct demo_recovery_election *election, bool cutover,
	bool confirmed);
/** A decided election permits exactly one OTAR through successful cutover. */
bool demo_recovery_otar_submission_allowed(
	const struct demo_recovery_election *election, bool pending,
	bool retained_keys, bool cutover);
/** Mark only the first authenticated operational packet after cutover. */
bool demo_recovery_mark_confirmed(bool cutover, bool *confirmed);
/** Confirm a repeated out-of-range CLCW while ignoring one stale datagram. */
bool demo_clcw_divergence_observe(struct demo_clcw_divergence *state,
				  bool out_of_range, uint8_t report_value,
				  uint64_t now_ms, uint64_t confirmation_ms);
#endif /* CCSDS_EYE_DEMO_PROTOCOL_H */
```

## src/demo_sdls_feedback.c
```c
/* SPDX-License-Identifier: Apache-2.0 */

#include "demo_sdls_feedback.h"

#include <string.h>

#include <zephyr/sys/byteorder.h>
#include <zephyr/sys/util.h>

void demo_sdls_feedback_latch_acceptance(
	struct demo_sdls_feedback_policy *policy,
	const uint8_t fsr[DEMO_SDLS_OCF_LEN])
{
	memcpy(policy->acceptance_fsr, fsr, sizeof(policy->acceptance_fsr));
	policy->acceptance_pending = true;
}

void demo_sdls_feedback_confirm_acceptance(
	struct demo_sdls_feedback_policy *policy)
{
	memset(policy->acceptance_fsr, 0, sizeof(policy->acceptance_fsr));
	policy->acceptance_pending = false;
}

bool demo_sdls_feedback_select_fsr(struct demo_sdls_feedback_policy *policy,
				   const uint8_t clcw[DEMO_SDLS_OCF_LEN],
				   const uint8_t current_fsr[DEMO_SDLS_OCF_LEN],
				   bool cop_urgent,
				   uint8_t selected[DEMO_SDLS_OCF_LEN])
{
	uint32_t word = sys_get_be32(clcw);
	uint8_t report = (uint8_t)word;
	bool flags_urgent = (word & (BIT(13) | BIT(12) | BIT(11))) != 0u;
	bool report_changed = !policy->report_valid || report != policy->last_report;

	policy->last_report = report;
	policy->report_valid = true;
	if (policy->acceptance_pending) {
		if (policy->previous_fsr) {
			policy->previous_fsr = false;
			memcpy(selected, clcw, DEMO_SDLS_OCF_LEN);
			return false;
		}
		policy->previous_fsr = true;
		memcpy(selected, policy->acceptance_fsr,
		       sizeof(policy->acceptance_fsr));
		return true;
	}
	if (policy->previous_fsr || cop_urgent || flags_urgent || report_changed) {
		policy->previous_fsr = false;
		if (policy->clcw_streak < DEMO_SDLS_CLCWS_PER_FSR) {
			policy->clcw_streak++;
		}
		memcpy(selected, clcw, DEMO_SDLS_OCF_LEN);
		return false;
	}
	if (policy->clcw_streak < DEMO_SDLS_CLCWS_PER_FSR) {
		policy->clcw_streak++;
		memcpy(selected, clcw, DEMO_SDLS_OCF_LEN);
		return false;
	}
	policy->clcw_streak = 0u;
	policy->previous_fsr = true;
	memcpy(selected, current_fsr, DEMO_SDLS_OCF_LEN);
	return true;
}
```

## src/demo_sdls_feedback.h
```c
/* SPDX-License-Identifier: Apache-2.0 */

#ifndef CCSDS_EYE_DEMO_SDLS_FEEDBACK_H
#define CCSDS_EYE_DEMO_SDLS_FEEDBACK_H

#include <stdbool.h>
#include <stdint.h>

#define DEMO_SDLS_CLCWS_PER_FSR 3u
#define DEMO_SDLS_OCF_LEN        4u

struct demo_sdls_feedback_policy {
	uint8_t acceptance_fsr[DEMO_SDLS_OCF_LEN];
	uint8_t clcw_streak;
	uint8_t last_report;
	bool report_valid;
	bool previous_fsr;
	bool acceptance_pending;
};

/** Retain an OTAR-acceptance FSR until new-key traffic confirms the cutover. */
void demo_sdls_feedback_latch_acceptance(
	struct demo_sdls_feedback_policy *policy,
	const uint8_t fsr[DEMO_SDLS_OCF_LEN]);

/** Stop repeating a retained OTAR-acceptance FSR. */
void demo_sdls_feedback_confirm_acceptance(
	struct demo_sdls_feedback_policy *policy);

/** Select one complete OCF, returning true when @p selected contains an FSR. */
bool demo_sdls_feedback_select_fsr(struct demo_sdls_feedback_policy *policy,
				   const uint8_t clcw[DEMO_SDLS_OCF_LEN],
				   const uint8_t current_fsr[DEMO_SDLS_OCF_LEN],
				   bool cop_urgent,
				   uint8_t selected[DEMO_SDLS_OCF_LEN]);

#endif /* CCSDS_EYE_DEMO_SDLS_FEEDBACK_H */
```

## src/demo_ui.h
```c
/* SPDX-License-Identifier: Apache-2.0 */

#ifndef CCSDS_EYE_DEMO_UI_H
#define CCSDS_EYE_DEMO_UI_H

#include <stdint.h>

#include "demo_service.h"

struct device;

void demo_ui_init(void);
void demo_ui_handle_key(uint16_t code, int32_t value);
void demo_ui_handle_event(const struct demo_ui_event *event);
void demo_ui_tick(uint32_t now_ms);
bool demo_ui_image_active(void);
bool demo_ui_link_active(void);
int demo_ui_render_image(const struct device *display);
void demo_ui_toggle_show(void);
void demo_ui_enter_link(void);
void demo_ui_leave_link(void);
void demo_ui_prepare_action(void);
void demo_ui_report_busy(void);
void demo_ui_report_link_queued(enum demo_link_action action);

#endif /* CCSDS_EYE_DEMO_UI_H */
```
